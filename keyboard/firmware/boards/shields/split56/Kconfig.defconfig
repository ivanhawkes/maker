## keyboard/firmware/config/west.yml
```yaml
# West manifest for the keyboard firmware. Both revisions are pinned (docs/decisions.md):
# re-pin deliberately and record why.
manifest:
  remotes:
    - name: zmkfirmware
      url-base: https://github.com/zmkfirmware
    - name: englmaxi
      url-base: https://github.com/englmaxi
  projects:
    - name: zmk
      remote: zmkfirmware
      revision: 4de313367288aad5aeaa1243890e40dc813f7008   # main, 2026-11-14; Zephyr v4.1.0+zmk-fixes
      import: app/west.yml
    - name: zmk-dongle-display
      remote: englmaxi
      revision: 2bb333f87136d33e94a49d86236ed9ec254a8060   # main, 2026-02-13
  self:
    path: config
```

## keyboard/firmware/dts/bindings/led-strip-fade.yaml
```yaml
# A led strip that fades another one in and out: firmware/src/led_strip_fade.c.

description: Passes frames on to another led strip, faded in when lit and out before ZMK's idle timeout

compatible: "led-strip-fade"

properties:
  led-strip:
    type: phandle
    required: true
    description: The strip that has the LEDs
  chain-length:
    type: int
    required: true
    description: The number of LEDs, as on that strip (ZMK reads it from its chosen strip)
  fade-in-ms:
    type: int
    required: true
    description: Black to full when the lighting starts or a key ends a fade-out
  fade-out-ms:
    type: int
    required: true
    description: Full to black, ending at CONFIG_ZMK_IDLE_TIMEOUT
```
